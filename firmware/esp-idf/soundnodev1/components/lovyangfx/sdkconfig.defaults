## firmware/esp-idf/soundnodev1/components/lovyangfx/sdkconfig.defaults
```kconfig
# --- Bluetooth Classic enabled ---
CONFIG_BT_ENABLED=y
CONFIG_BT_CLASSIC_ENABLED=y
CONFIG_BT_BLE_ENABLED=n

# More stack for BT + UI
CONFIG_MAIN_TASK_STACK_SIZE=8192

# FATFS / VFS
CONFIG_FATFS_LFN_HEAP=y
CONFIG_FATFS_MAX_LFN=255

# Logging
CONFIG_LOG_DEFAULT_LEVEL_INFO=y
```
